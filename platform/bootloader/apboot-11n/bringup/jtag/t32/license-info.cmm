// T32 Thu Jul 14 15:30:39 2011

 B::
 
 TOOLBAR ON
 STATUSBAR ON
 CMDPOS 0.71429 1.8462 114. 12.
 WINPAGE.RESET
 
 WINCLEAR
 WINPOS 0.0 28.923 87. 30. 0. 0. W002
 VERSION.SOFTWARE
 
 WINPOS 0.71429 16.846 91. 4. 0. 0. W001
 VERSION.HARDWARE
 
 WINPOS 110.14 30.385 46. 20. 0. 0. W000
 VERSION
 
 WINPOS 2.7143 63.154 80. 5. 0. 0. W003
 LICENSE.List
 
 WINPAGE.SELECT P000     
 
 ENDDO
