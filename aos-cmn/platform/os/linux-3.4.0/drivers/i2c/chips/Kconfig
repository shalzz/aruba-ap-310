## aos-cmn/platform/os/linux-3.4.0/drivers/i2c/chips/Kconfig
```kconfig
#
# Miscellaneous I2C chip drivers configuration
#
# *** DEPRECATED! Do not add new entries! See Makefile ***
#

menu "Miscellaneous I2C Chip support"

config TPM_AT97SC3203
	tristate "Atmel AT97SC3203S Trusted Platform Module driver"
	depends on I2C && EXPERIMENTAL
	help
	  If you say yes here you get support for Atmel AT97SC3203S
	  Trusted Platform Module.

	  This driver can also be built as a module.  If so, the module
	  will be called at97sc3203.
endmenu
```

## aos-cmn/platform/os/linux-3.4.0/lib/Kconfig.aruba
```kconfig
menu "Aruba options"
config OCTOMORE
       bool "Octomore AP"
       default n
config ARUBA_NET
       bool "Aruba AP Platform Support (legacy)"
config ARUBA_AP
	bool "platform is an Aruba AP"
	select ARUBA_NET
	select WIRELESS_EXT
	select WEXT_PRIV
	select WEXT_CORE
	default n
config ARUBA_DIAG
	bool "Enable Aruba diagnostic support"
	default n
config ARUBA_DEBUG
	bool "Enable Aruba debug logging"
	default n
config EIGER
       bool "Eiger AP"
       default n
endmenu
```

## aos-cmn/platform/os/linux-3.4.0/net/core/Kconfig
```kconfig
#
# Core configuration
#

config ARUBA_SKB_LEAK_DEBUGGING
	bool "SKB leak debugging"
	default Y
	help 
	  If you say Y here all skb allocations are tracked and can be dumped 
	  using "cat /proc/sys/net/core/allocated_skbs"

config ARUBA_SKB_TRACK
	bool "Track SKB status"
	default Y
	help 
	  If you say Y here skb double free is tracked  
config ARUBA_SKB_QUARANTINE
	bool "QUARANTINE SKB"
	default N
	help 
	  If you say Y here skb can be quarantined  
```
